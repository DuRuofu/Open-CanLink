## software/esp32/can_bridge/sdkconfig.defaults
```kconfig
# esp-can-link bridge firmware - sdkconfig defaults
CONFIG_TINYUSB_CDC_ENABLED=y
CONFIG_TINYUSB_DESC_USE_ESPRESSIF_VID=y
```

## software/esp32/test/usb_cdc_echo/sdkconfig.defaults
```kconfig
# USB CDC echo test - sdkconfig defaults
CONFIG_TINYUSB_CDC_ENABLED=y
CONFIG_TINYUSB_DESC_USE_ESPRESSIF_VID=y
```
